## components/sunton_esp32s3_lvgl/Kconfig.projbuild
```kconfig
menu "Sunton ESP32-S3 based display LVGL Package config"

    orsource "$IDF_PATH/examples/common_components/env_caps/$IDF_TARGET/Kconfig.env_caps"

    choice SUNTON_ESP32_DISPLAY
        prompt "Display Type"
        default SUNTON_ESP32_8048S050C
        help
            Select Sunton ESP32 S3 Display Type

        config SUNTON_ESP32_8048S050C
            bool "ESP32-8048S050C (Capacitive Touch)"
        config SUNTON_ESP32_8048S050R
            bool "ESP32-8048S050R (Resistive Touch)"
    endchoice

    choice SUNTON_ESP32_TOUCH_TYPE
        bool "Touch Type"
        default SUNTON_ESP32_TOUCH_TYPE_CAPACITIVE if SUNTON_ESP32_8048S050C
        default SUNTON_ESP32_TOUCH_TYPE_RESISTIVE if SUNTON_ESP32_8048S050R
        default SUNTON_ESP32_TOUCH_TYPE_NONE

        config SUNTON_ESP32_TOUCH_TYPE_CAPACITIVE
            bool "Capacitive Touch"

        config SUNTON_ESP32_TOUCH_TYPE_RESISTIVE
            bool "Resistive Touch"

        config SUNTON_ESP32_TOUCH_TYPE_NONE
            bool "No Touch"
    endchoice

    config SUNTON_ESP32_DOUBLE_FB
        bool "Use Double Frame Buffer"
        default y

    config SUNTON_ESP32_DOUBLE_FB_TEARING
        bool "Avoid tearing effect"
        depends on SUNTON_ESP32_DOUBLE_FB
        default y

    config LVGL_TASK_MAX_DELAY_MS
        int "LVGL Port Task max delay in MS"
        default 500

    config LVGL_TASK_MIN_DELAY_MS
        int "LVGL Port Task min delay in MS"
        default 1

    config LVGL_TASK_STACK_SIZE
        int "LVGL Port Task stack size in KB"
        default 8

    config LVGL_TASK_PRIORITY
        int "LVGL Port Task prio"
        default 3
endmenu
```

## components/touch/Kconfig.projbuild
```kconfig
menu "ESP32-8048S050C Touch Configuration"

    orsource "$IDF_PATH/examples/common_components/env_caps/$IDF_TARGET/Kconfig.env_caps"

    config TOUCH_PIN_I2C_SCL
        int "Touch I2C SCL Pin"
        range ENV_GPIO_RANGE_MIN ENV_GPIO_OUT_RANGE_MAX
        default 20

    config TOUCH_PIN_I2C_SDA
        int "Touch I2C SDA Pin"
        range ENV_GPIO_RANGE_MIN ENV_GPIO_OUT_RANGE_MAX
        default 19

    config TOUCH_PIN_RST
        int "Touch Control reset Pin"
        range ENV_GPIO_RANGE_MIN ENV_GPIO_OUT_RANGE_MAX
        default 38

    config TOUCH_PIN_INT
        int "Touch Control Interrupt Pin"
        range ENV_GPIO_RANGE_MIN ENV_GPIO_OUT_RANGE_MAX
        default 18

    config TOUCH_I2C_PULLUP
        bool "Enable I2C Pullup"
        default n
        help
            not required, external pullups R3 / R4 in place

    choice TOUCH_GT911_ADDRESS
        prompt "I2C Address of GT911"
        default ESP_LCD_TOUCH_IO_I2C_GT911_ADDRESS_BACKUP
        help
            R5 is bound to VCC so GT911 has I2C address 0x14

        config ESP_LCD_TOUCH_IO_I2C_GT911_ADDRESS
            bool "ADDRESS"
        config ESP_LCD_TOUCH_IO_I2C_GT911_ADDRESS_BACKUP
            bool "ADDRESS BACKUP"
    endchoice
endmenu
```

## main/Kconfig.projbuild
```kconfig
menu "Sunton ESP32-S3 based display LVGL Package config"

    orsource "$IDF_PATH/examples/common_components/env_caps/$IDF_TARGET/Kconfig.env_caps"

    config SUNTON_ESP32_DOUBLE_FB
        bool "Use Double Frame Buffer"
        default y

    config SUNTON_ESP32_DOUBLE_FB_TEARING
        bool "Avoid tearing effect"
        depends on SUNTON_ESP32_DOUBLE_FB
        default y

    config LVGL_TASK_MAX_DELAY_MS
        int "LVGL Port Task max delay in MS"
        default 500

    config LVGL_TASK_MIN_DELAY_MS
        int "LVGL Port Task min delay in MS"
        default 1

    config LVGL_TASK_STACK_SIZE
        int "LVGL Port Task stack size in KB"
        default 8

    config LVGL_TASK_PRIORITY
        int "LVGL Port Task prio"
        default 3
endmenu
```
